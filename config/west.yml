## config/west.yml
```yaml
manifest:
  remotes:
    - name: zmkfirmware
      #url-base: https://github.com/zmkfirmware
      # change to ftc for mouse support
      url-base: https://github.com/ftc/
  projects:
    - name: zmk
      remote: zmkfirmware
      revision: mouse-ftc # main
      import: app/west.yml
  self:
    path: config
```
